#include <Servo.h>
#include <IRremote.h>
int RECV_PIN = 11;  // IR 수신기 p11에 연결
int buzzer = 3;     // 스피커 3에 연결

// 아기상어_노래
int tones[] = { 587, 659, 784, 784, 784, 784, 784, 784, 784, 784, 587, 659, 784,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 740, 0 };
int beats[] = { 10, 10, 5, 5, 5, 2.5, 2.5, 2.5, 2.5, 5, 5, 5, 5,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 5, 10 };
int tempo = 100;

// 사랑을 했다_노래
int tones2[] = {0, 988, 880, 784, 988, 1175, 0, 988, 880, 784, 988, 880, 0,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 784, 0};
int beats2[] = {5, 5, 5, 5, 5, 15, 5, 5, 5, 5, 5, 15, 10,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 15, 10};
int tempo2 = 100;

Servo myservo1;  // 서보모터1
Servo myservo2;  // 서보모터2


IRrecv irrecv(RECV_PIN);  // RECV_PIN으로 IR 수신하는 IRrecv 클래스 객체에 irrecv를 생성
decode_results results;   // IR리모콘으로부터 받은 데이터


void setup() {

  Serial.begin(9600);   // 시리얼 통신 시작
  irrecv.enableIRIn();  // 리모콘 수신 시작
  myservo1.attach(9);   // 9번 핀에 서버모터1 연결
  myservo2.attach(10);  // 10번 핀에 서버모터2 연결
  pinMode(3, OUTPUT);   // 스피커 출력
}


void loop() {

  if (irrecv.decode(&results)) {
    Serial.println(results.value, HEX);
    irrecv.resume();  // 리모컨 신호 받기
  }

  if (results.value == 16761405) {  // play버튼 누를시 노래 시작

    for (int i = 0; i < sizeof(beats) / sizeof(int); i++) {
      int angle = 0;
      if (tones[i] == 0) {
        noTone(buzzer);

        angle += 100;          // 서보모터 회전
        myservo2.write(angle);
        myservo1.write(angle);


        delay(tempo / 2 * beats[i]);    // 박자 계산 맞추기
        angle += 100;          // 서보모터 회전
        myservo2.write(angle);
        myservo1.write(angle);


      } else {
        tone(buzzer, tones[i]);

        delay(tempo / 2 * beats[i]);
        angle += 100;
        myservo2.write(angle);
        myservo1.write(angle);


        noTone(buzzer);
        angle += 100;
        myservo2.write(angle);
        myservo1.write(angle);
      }
    }
  }

  if (results.value == 16724175) {  // 1번 버튼 누를시 다른 노래 출력

    for (int j = 0; j < sizeof(beats2) / sizeof(int); j++) {
      int angle = 0;

      if (tones2[j] == 0) {
        noTone(buzzer);

        angle += 100;
        myservo2.write(angle);
        myservo1.write(angle);

        delay(tempo2 / 2 * beats2[j]);
        angle += 100;
        myservo2.write(angle);
        myservo1.write(angle);

      } else {
        tone(buzzer, tones2[j]);
        delay(tempo2 / 2 * beats2[j]);

        angle += 100;
        myservo2.write(angle);
        myservo1.write(angle);

        noTone(buzzer);
        angle += 100;
        myservo2.write(angle);
        myservo1.write(angle);
      }
    }

    noTone(buzzer);
    delay(1000);
  }
}
